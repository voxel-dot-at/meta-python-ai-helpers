## conf/layer.conf
```bitbake
# We have a conf and classes directory, append to BBPATH
BBPATH .= ":${LAYERDIR}"

# We have recipes-* directories, add to BBFILES
BBFILES += "${LAYERDIR}/recipes-*/*/*.bb \
	    ${LAYERDIR}/recipes-*/*/*.bbappend"


BBFILE_COLLECTIONS += "python-ai-helpers-layer"
BBFILE_PATTERN_python-ai-helpers-layer := "^${LAYERDIR}/"
BBFILE_PRIORITY_python-ai-helpers-layer = "38"

LAYERDEPENDS_python-ai-helpers-layer = " core openembedded-layer "

LAYERSERIES_COMPAT_python-ai-helpers-layer = "scarthgap styhead"
```
